## Projeto_Final/Teste_de_Servo/main/Kconfig.projbuild
```kconfig
menu "Wi-Fi Connection"

    config ESP_WIFI_SSID
        string "SSID"
        default "Not set"
        help
            Nome do Wi-Fi

    config ESP_WIFI_PASSWORD
        string "PASSWORD"
        default "Not set"
        help
            Senha Wi-Fi

    config ESP_MAXIMUM_RETRY
        int "Maximum Retry"
        default 5
        help
            Tentativas de reconexão
endmenu
```
